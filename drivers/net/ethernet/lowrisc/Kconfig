## drivers/net/ethernet/lowrisc/Kconfig
```kconfig
#
# Xilinx device configuration
#

config NET_VENDOR_LOWRISC
	bool "lowRISC devices"
	default y
	depends on RISCV
	help
	  If you have a network (Ethernet) card belonging to this class, say Y.

	  Note that the answer to this question doesn't directly affect the
	  kernel: saying N will just cause the configurator to skip all
	  the questions about lowRISC devices. If you say Y, you will be asked
	  for your specific card in the following questions.

if NET_VENDOR_LOWRISC

config LOWRISC_DIGILENT_100MHZ
	tristate "lowRISC 100MHz Ethernet Nexys4_DDR support"
	depends on RISCV
	select PHYLIB
	help
	  This driver supports the 100MHz Ethernet for Nexys4_DDR Digilent boards from lowRISC.

endif # NET_VENDOR_LOWRISC
```
